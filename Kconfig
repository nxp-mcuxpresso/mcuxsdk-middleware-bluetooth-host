## Kconfig
```kconfig
menu "bluetooth"
    config MCUX_COMPONENT_middleware.wireless.ble_host
        bool "host"
    config MCUX_COMPONENT_middleware.wireless.ble_host_common
        bool "host_common"
    config MCUX_COMPONENT_middleware.wireless.ble_host_OPT_component_lib
        bool "host_opt_lib"
    config MCUX_COMPONENT_middleware.wireless.ble_host_OPT_central_component_lib
        bool "host_opt_central_lib"
    config MCUX_COMPONENT_middleware.wireless.ble_host_OPT_peripheral_component_lib
        bool "host_opt_peripheral_lib"
    config MCUX_COMPONENT_middleware.wireless.ble_host_component_lib
        bool "host_lib"
    config MCUX_COMPONENT_middleware.wireless.ble_host_central_component_lib
        bool "host_central_lib"
    config MCUX_COMPONENT_middleware.wireless.ble_host_peripheral_component_lib
        bool "host_peripheral_lib"
    config MCUX_COMPONENT_middleware.wireless.ble_host_matter_component_lib
        bool "host_matter_lib"
    config MCUX_COMPONENT_middleware.wireless.ble_host_interface
        bool "host_interface"
    config MCUX_COMPONENT_middleware.wireless.ble_host_xml
        bool "host_xml"
    config MCUX_COMPONENT_middleware.wireless.ble_host_sdk
        bool "host_sdk"
    config MCUX_COMPONENT_middleware.wireless.ble_host_interface_black_box
        bool "host_interface_black_box"
    config MCUX_COMPONENT_middleware.wireless.ble_host_interface_host
        bool "host_interface_host"
    config MCUX_COMPONENT_middleware.wireless.ble_host_interface_genfsk
        bool "host_interface_genfsk"
    config MCUX_COMPONENT_middleware.wireless.ble_fsci_interface
        bool "fsci_interface"
    config MCUX_COMPONENT_middleware.wireless.ble_fsci_private_interface
        bool "fsci_private_interface"
    config MCUX_COMPONENT_middleware.wireless.ble_fsci_generic
        bool "fsci_generic"
    config MCUX_COMPONENT_middleware.wireless.ble_fsci_source
        bool "fsci_source"
    config MCUX_COMPONENT_middleware.wireless.ble_fsci_source_handover
        bool "fsci_source_handover"
    config MCUX_COMPONENT_middleware.wireless.ble_fsci_host
        bool "fsci_host"
    config MCUX_COMPONENT_middleware.wireless.ble_host_interface_handover
        bool "host_interface_handover"
    config MCUX_COMPONENT_middleware.wireless.auto
        bool "auto"
    config MCUX_COMPONENT_middleware.wireless.ble_init_matter
        bool "init_matter"
    config MCUX_COMPONENT_middleware.wireless.ble_hci_transport_serial
        bool "hci_transport_serial"
    config MCUX_COMPONENT_middleware.wireless.ble_hci_transport_rpmsg
        bool "hci_transport_rpmsg"
    config MCUX_COMPONENT_middleware.wireless.ble_hci_transport_ipm
        bool "hci_transport_ipm"
    config MCUX_COMPONENT_middleware.wireless.ble_hci_transport_adapter
        bool "hci_transport_adapter"
    config MCUX_COMPONENT_middleware.wireless.ble_hci_transport_interface
        bool "hci_transport_interface"
    config MCUX_COMPONENT_middleware.wireless.ble_gatt_db_dynamic
        bool "gatt_db_dynamic"
    config MCUX_COMPONENT_middleware.wireless.ble_gatt_service_discovery
        bool "gatt_service_discovery"
    config MCUX_COMPONENT_middleware.wireless.ble_gatt_db
        bool "gatt_db"
    config MCUX_COMPONENT_middleware.wireless.ble_profiles_battery_service
        bool "profiles_battery_service"
    config MCUX_COMPONENT_middleware.wireless.ble_profiles_ncp_battery_service
        bool "profiles_ncp_battery_service"
    config MCUX_COMPONENT_middleware.wireless.ble_profiles_device_info_service
        bool "profiles_device_info_service"
    config MCUX_COMPONENT_middleware.wireless.ble_profiles_ancs
        bool "profiles_ancs"
    config MCUX_COMPONENT_middleware.wireless.ble_profiles_time
        bool "profiles_time"
    config MCUX_COMPONENT_middleware.wireless.ble_profiles_hid
        bool "profiles_hid"
    config MCUX_COMPONENT_middleware.wireless.ble_profiles_temperature
        bool "profiles_temperature"
    config MCUX_COMPONENT_middleware.wireless.ble_profiles_health_thermometer
        bool "profiles_health_thermometer"
    config MCUX_COMPONENT_middleware.wireless.ble_profiles_wireless_uart
        bool "profiles_wireless_uart"
    config MCUX_COMPONENT_middleware.wireless.ble_profiles_otap
        bool "profiles_otap"
    config MCUX_COMPONENT_middleware.wireless.ble_profiles_digital_key
        bool "profiles_digital_key"
    config MCUX_COMPONENT_middleware.wireless.ble_ncp_common
        bool "ble_ncp_common"
    config MCUX_COMPONENT_middleware.wireless.ble_ncp_fsci_source
        bool "ble_ncp_fsci_source"
    config MCUX_COMPONENT_middleware.wireless.ncp
        bool "ncp"
    config MCUX_COMPONENT_middleware.wireless.bridge_nvm
        bool "Component middleware.wireless.bridge_nvm"
    config MCUX_COMPONENT_middleware.wireless.ble_ncp_fsci_types_pub
        bool "ble_ncp_fsci_types_pub"
    config MCUX_COMPONENT_middleware.wireless.loc_ncp_nvm
        bool "loc_ncp_nvm"
    config MCUX_COMPONENT_middleware.wireless.ble_port_fsci
        bool "ble_port_fsci"
    orsource "application/common/ble_port_fsci/core1/Kconfig"
    orsource "application/common/ble_port_fsci/core0/Kconfig"
endmenu

menu "localization"
    config MCUX_COMPONENT_middleware.wireless.genfsk_wr_lcl_algo_cm33_lib
        bool "genfsk_wr_lcl_algo_cm33_lib"
        select MCUX_COMPONENT_CMSIS_DSP_Source
    config MCUX_COMPONENT_middleware.wireless.genfsk_wr_lcl_algo_cm33_lce_lib
        bool "genfsk_wr_lcl_algo_cm33_lce_lib"
        select MCUX_COMPONENT_CMSIS_DSP_Source
    config MCUX_COMPONENT_middleware.wireless.genfsk_lcl_isp_controller_wr
        bool "genfsk_lcl_isp_controller_wr"
    config MCUX_COMPONENT_middleware.wireless.wr_wireless_ranging_host
        bool "wr_wireless_ranging_host"
    config MCUX_COMPONENT_middleware.wireless.wr_wireless_ranging_tools
        bool "wr_wireless_ranging_tools"
    config MCUX_COMPONENT_middleware.wireless.lcl
        bool "lcl"
    config MCUX_COMPONENT_middleware.wireless.lcl_algo
        bool "lcl_algo"
    config MCUX_COMPONENT_middleware.wireless.lcl_pts_test
        bool "lcl_pts_test"
    config MCUX_COMPONENT_middleware.wireless.ble_profiles_ranging
        bool "ble_profiles_ranging"
    config MCUX_COMPONENT_middleware.wireless.ble_profiles_ranging_client
        bool "ble_profiles_ranging_client"
    config MCUX_COMPONENT_middleware.wireless.ble_btcs_client
        bool "ble_btcs_client"
    config MCUX_COMPONENT_middleware.wireless.ble_btcs_server
        bool "ble_btcs_server"
    config MCUX_COMPONENT_middleware.wireless.ble_host_CS
        bool "ble_host_CS"
    config MCUX_COMPONENT_middleware.wireless.ble_host_CS_component_lib
        bool "ble_host_CS_lib"
endmenu
```

## application/common/ble_port_fsci/core0/Kconfig
```kconfig
config MCUX_COMPONENT_middleware.wireless.ble_port_fsci_component_button_core0
    bool "ble_port_fsci_component_button_core0"
config MCUX_COMPONENT_middleware.wireless.ble_port_fsci_component_led_core0
    bool "ble_port_fsci_component_led_core0"
config MCUX_COMPONENT_middleware.wireless.ble_port_fsci_component_reset_core0
    bool "ble_port_fsci_component_reset_core0"
config MCUX_COMPONENT_middleware.wireless.ble_port_fsci_shell_core0
    bool "ble_port_fsci_shell_core0"
config MCUX_COMPONENT_middleware.wireless.ble_port_fsci_component_nvm_core0
    bool "ble_port_fsci_component_nvm_core0"
config MCUX_COMPONENT_middleware.wireless.ble_port_fsci_component_platform_core0
    bool "ble_port_fsci_component_platform_core0"
config MCUX_COMPONENT_middleware.wireless.ble_port_fsci_component_sensors_core0
    bool "ble_port_fsci_component_sensors_core0"
```

## application/common/ble_port_fsci/core1/Kconfig
```kconfig
config MCUX_COMPONENT_middleware.wireless.ble_port_fsci_component_button_core1
    bool "ble_port_fsci_component_button_core1"
config MCUX_COMPONENT_middleware.wireless.ble_port_fsci_component_led_core1
    bool "ble_port_fsci_component_led_core1"
config MCUX_COMPONENT_middleware.wireless.ble_port_fsci_sensors_core1
    bool "ble_port_fsci_sensors_core1"
config MCUX_COMPONENT_middleware.wireless.ble_port_fsci_component_reset_core1
    bool "ble_port_fsci_component_reset_core1"
config MCUX_COMPONENT_middleware.wireless.ble_port_fsci_platform_core1
    bool "ble_port_fsci_platform_core1"
config MCUX_COMPONENT_middleware.wireless.ble_port_fsci_component_lcl_core1
    bool "ble_port_fsci_component_lcl_core1"
config MCUX_COMPONENT_middleware.wireless.ble_port_fsci_shell_core1
    bool "ble_port_fsci_shell_core1"
config MCUX_COMPONENT_middleware.wireless.ble_port_fsci_nvm_core1
    bool "ble_port_fsci_nvm_core1"
```
